## CMakeLists.txt
```
cmake_minimum_required(VERSION 3.13.1)

set(BOARD nrf52840dk_nrf52840)
find_package(Zephyr REQUIRED HINTS $ENV{ZEPHYR_BASE})
project(air-quality-smart-sensors-network)

target_sources(app PRIVATE 
    src/main.c
    sensors/ccs811/ccs811.c
    sensors/sps30/sps30.c
    sensors/sps30/hal.c
    sensors/scd41/scd4x_i2c.c
    sensors/scd41/sensirion_common.c
    sensors/scd41/sensirion_i2c_hal.c
    sensors/scd41/sensirion_i2c.c
)
```

## prj.conf
```kconfig
# Enable OpenThread FTD features set
# CONFIG_OPENTHREAD_NORDIC_LIBRARY_FTD=y
# L2 OpenThread enabling
CONFIG_NET_L2_OPENTHREAD=y
# Generic networking options
CONFIG_NETWORKING=y
# Network parameter
CONFIG_OPENTHREAD_MANUAL_START=n
CONFIG_OPENTHREAD_NETWORK_NAME="WSN"
CONFIG_OPENTHREAD_PANID=64256
CONFIG_OPENTHREAD_XPANID="fb:02:fb:02:fb:02:00:00"
CONFIG_OPENTHREAD_NETWORKKEY="00:11:22:33:44:55:66:77:88:99:aa:bb:cc:dd:ee:ff"

CONFIG_OPENTHREAD_JOINER=y
CONFIG_OPENTHREAD_JOINER_AUTOSTART=y
CONFIG_OPENTHREAD_JOINER_PSKD="J01NME"

# Network shell
CONFIG_SHELL=y
CONFIG_OPENTHREAD_SHELL=y
CONFIG_SHELL_ARGC_MAX=26
CONFIG_SHELL_CMD_BUFF_SIZE=416
#Additional parameter
# CONFIG_MBEDTLS_SHA1_C=n
CONFIG_FPU=y
CONFIG_GPIO=y
# Enable OpenThread CoAP support API
CONFIG_OPENTHREAD_COAP=y

CONFIG_I2C=y
CONFIG_SENSOR=y

CONFIG_NEWLIB_LIBC=y
CONFIG_NEWLIB_LIBC_FLOAT_PRINTF=y

CONFIG_PWM=y
CONFIG_CBPRINTF_FP_SUPPORT=y
```

## src/main.c
```c
#include <stdio.h>
#include <zephyr/kernel.h>
#include <zephyr/device.h>
#include <zephyr/drivers/gpio.h>
#include <zephyr/net/openthread.h>
#include <zephyr/net/coap.h>
#include <openthread/thread.h>
#include <openthread/udp.h>
#include <openthread/coap.h>
#include <zephyr/drivers/sensor.h>
#include <zephyr/drivers/i2c.h>
#include <zephyr/sys/printk.h>
#include <zephyr/sys/util.h>
#include "../sensors/scd41/scd4x_i2c.h"
#include "../sensors/scd41/sensirion_common.h"
#include "../sensors/scd41/sensirion_i2c_hal.h"
#include "../sensors/ccs811/ccs811.h"
#include "../sensors/sps30/sps30.h"

#define SLEEP_TIME_MS 1000
#define DATA_SENDING_INTERVAL 10000
#define TEXTBUFFER_SIZE 30
#define BUTTON0_NODE DT_NODELABEL(button0)
#define BUTTON1_NODE DT_NODELABEL(button1)

static const struct gpio_dt_spec button0_spec = GPIO_DT_SPEC_GET(BUTTON0_NODE, gpios);
static const struct gpio_dt_spec button1_spec = GPIO_DT_SPEC_GET(BUTTON1_NODE, gpios);
static struct gpio_callback button_cb;

static struct k_timer send_timer;
static volatile bool function_running = false;

int16_t get_serial(int16_t error, int16_t serial_0, int16_t serial_1, int16_t serial_2);
void read_scd41();
void read_ccs811(struct ccs811_data *ccs811);
void read_sps30();

static void coap_send_data_request(struct k_work *work);
static void coap_send_data_response_cb(void *p_context, otMessage *p_message, const otMessageInfo *p_message_info, otError result);

struct sensor_value temperature, humidity, co2, eco2, tvoc;
struct ccs811_data ccs811;
struct sps30_measurement m;
int16_t ret;

#define I2C_DEV DT_LABEL(DT_ALIAS(i2c0))
#define I2C_NODE DT_NODELABEL(i2c0)
#define I2C_DEV_LABEL DT_LABEL(DT_NODELABEL(i2c0))
#define CCS811_I2C_ADDRESS 0x5A

int16_t get_serial(int16_t error, int16_t serial_0, int16_t serial_1, int16_t serial_2)
{
        error = scd4x_get_serial_number(&serial_0, &serial_1, &serial_2);
        return error;
}

void read_scd41()
{
        int16_t error;
        bool data_ready_flag = false;
        error = scd4x_get_data_ready_flag(&data_ready_flag);
        if (error)
        {
                printf("Error executing scd4x_get_data_ready_flag(): %i\n", error);
                return;
        }
        if (!data_ready_flag)
        {
                return;
        }

        error = scd4x_read_measurement(&co2, &temperature, &humidity);
        if (error)
        {
                printf("Error executing scd4x_read_measurement(): %i\n", error);
                return;
        }
        else if (sensor_value_to_double(&co2) == 0)
        {
                printf("Invalid sample detected, skipping.\n");
        }
}

void read_ccs811(struct ccs811_data *ccs811)
{
        if (ccs811_data_ready(ccs811))
        {
                if (ccs811_read(ccs811, &eco2, &tvoc) == 0)
                {
                        printk("Data read from CCS811\n");
                }
                else
                {
                        printk("Failed to read CCS811 sensor data\n");
                }
        }
        else
        {
                printk("CCS811 data not ready\n");
        }
}

void read_sps30()
{
        sensirion_sleep_usec(SPS30_MEASUREMENT_DURATION_USEC);
        ret = sps30_read_measurement(&m);
        if (ret < 0)
        {
                printk("Error reading measurement\n");
        }
        else
        {
                printk("SPS30:\n"
                       "PM1.0: %0.2f ug/m3\n"
                       "PM2.5: %0.2f ug/m3\n"
                       "PM4.0: %0.2f ug/m3\n"
                       "PM10: %0.2f ug/m3\n"
                       "NC0.5: %0.2f #/cm3\n"
                       "NC1.0: %0.2f #/cm3\n"
                       "NC2.5: %0.2f #/cm3\n"
                       "NC4.0: %0.2f #/cm3\n"
                       "NC10: %0.2f #/cm3\n"
                       "Typical Particle Size: %0.2f um\n\n",
                       m.mc_1p0, m.mc_2p5, m.mc_4p0, m.mc_10p0, m.nc_0p5, m.nc_1p0,
                       m.nc_2p5, m.nc_4p0, m.nc_10p0, m.typical_particle_size);
        }
}

static void coap_send_data_request(struct k_work *work)
{
        char sensors_data[160];
        otError error = OT_ERROR_NONE;
        otMessage *myMessage;
        otMessageInfo myMessageInfo;
        otInstance *myInstance = openthread_get_default_instance();
        const char *serverIpAddr = "fd00:0:fb01:1:c9bd:dc9d:23e:82c5";

        printk("Sending payload!\n");

        do
        {
                read_scd41();
                read_ccs811(&ccs811);
                read_sps30();

                myMessage = otCoapNewMessage(myInstance, NULL);
                if (myMessage == NULL)
                {
                        printk("Failed to allocate message for CoAP Request\n");
                        return;
                }
                otCoapMessageInit(myMessage, OT_COAP_TYPE_CONFIRMABLE, OT_COAP_CODE_PUT);
                error = otCoapMessageAppendUriPathOptions(myMessage, "storedata");
                if (error != OT_ERROR_NONE)
                {
                        break;
                }
                error = otCoapMessageAppendContentFormatOption(myMessage, OT_COAP_OPTION_CONTENT_FORMAT_JSON);
                if (error != OT_ERROR_NONE)
                {
                        break;
                }
                error = otCoapMessageSetPayloadMarker(myMessage);
                if (error != OT_ERROR_NONE)
                {
                        break;
                }
                printk("%.2f", sensor_value_to_double(&tvoc));
                const double calculated_humidity = sensor_value_to_double(&humidity) / 1000.0;
                const double calculated_temperature = sensor_value_to_double(&temperature) / 1000.0;
                snprintf(sensors_data, sizeof(sensors_data),
                         "{\"CO\":%.2f,\"Hm\":%.2f,\"Tp\":%.2f,\"eCO\":%.2f,\"1p0\":%.2f,\"2p5\":%.2f,\"4p0\":%.2f,\"10p0\":%.2f,\"ps\":%.2f}",
                         sensor_value_to_double(&co2),
                         calculated_humidity,
                         calculated_temperature,
                         sensor_value_to_double(&eco2),
                         m.mc_1p0,
                         m.mc_2p5, m.mc_4p0, m.mc_10p0, m.typical_particle_size);
                //  sensor_value_to_double(&tvoc),
                sensors_data[159] = '\0';

                error = otMessageAppend(myMessage, sensors_data, strlen(sensors_data));
                if (error != OT_ERROR_NONE)
                {
                        printk("Ops!");
                        break;
                }
                memset(sensors_data, 0, sizeof(sensors_data));
                memset(&myMessageInfo, 0, sizeof(myMessageInfo));
                myMessageInfo.mPeerPort = OT_DEFAULT_COAP_PORT;

                error = otIp6AddressFromString(serverIpAddr, &myMessageInfo.mPeerAddr);
                if (error != OT_ERROR_NONE)
                {
                        break;
                }

                error = otCoapSendRequest(myInstance, myMessage, &myMessageInfo, coap_send_data_response_cb, NULL);

        } while (false);
        if (error != OT_ERROR_NONE)
        {
                printk("Failed to send CoAP Request: %d\n", error);
                otMessageFree(myMessage);
        }
        else
        {
                printk("CoAP data send.\n");
        }
        // free(sensors_data);
}

K_WORK_DEFINE(sensor_work, coap_send_data_request);

static void coap_send_data_response_cb(void *p_context, otMessage *p_message, const otMessageInfo *p_message_info, otError result)
{
        if (result == OT_ERROR_NONE)
        {
                printk("Delivery confirmed.\n");
        }
        else
        {
                printk("Delivery not confirmed: %d\n", result);
        }
}

void coap_init()
{
        otInstance *p_instance = openthread_get_default_instance();
        otError error = otCoapStart(p_instance, OT_DEFAULT_COAP_PORT);
        if (error != OT_ERROR_NONE)
                printk("Failed to start Coap: %d\n", error);
        else
                printk("COAP init success!\n");
}

void button_pressed_cb(const struct device *dev, struct gpio_callback *cb, uint32_t pins)
{
        if (pins & BIT(button0_spec.pin))
        {
                function_running = true;
                printk("Start sending data....\n");
                k_timer_start(&send_timer, K_NO_WAIT, K_MSEC(DATA_SENDING_INTERVAL));
        }
        else if (pins & BIT(button1_spec.pin))
        {
                function_running = false;
                printk("Stop sending data....\n");
                k_timer_stop(&send_timer);
        }
}

void send_timer_callback(struct k_timer *timer_id)
{
        if (function_running)
        {
                printk("Submitting worker.\n");
                k_work_submit(&sensor_work);
        }
}

int main(void)
{
        printk("Initializing SCD41\n");
        int16_t error = 0;
        sensirion_i2c_hal_init();
        scd4x_wake_up();
        scd4x_stop_periodic_measurement();
        scd4x_reinit();

        uint16_t serial_0 = 0;
        uint16_t serial_1 = 0;
        uint16_t serial_2 = 0;

        error = get_serial(error, serial_0, serial_1, serial_2);
        if (error)
        {
                printk("Error executing scd4x_get_serial_number(): %i\n", error);
        }
        else
        {
                printk("serial: 0x%04x%04x%04x\n", serial_0, serial_1, serial_2);
        }

        error = scd4x_start_periodic_measurement();
        if (error)
        {
                printk("Error executing scd4x_start_periodic_measurement(): %i\n", error);
        }

        printk("Initializing CCS811\n");

        static const struct device *i2c_dev = DEVICE_DT_GET(I2C_NODE);

        sensirion_i2c_init();

        if (i2c_dev == NULL)
        {
                printk("Failed to get I2C device\n");
                return -1;
        }
        printk("I2C device found\n");

        if (ccs811_init(&ccs811, i2c_dev, CCS811_I2C_ADDRESS) != 0)
        {
                printk("Failed to initialize CCS811 sensor\n");
        }
        printk("CCS811 initialized\n");

        while (sps30_probe() != 0)
        {
                printk("SPS30 sensor probing failed\n");
                k_sleep(K_SECONDS(1));
        }
        printk("SPS sensor probing successful\n");

        ret = sps30_start_measurement();
        if (ret < 0)
                printk("Error starting measurement\n");

        printk("Initializing COAP\n");
        coap_init();

        gpio_pin_configure_dt(&button0_spec, GPIO_INPUT);
        gpio_pin_interrupt_configure_dt(&button0_spec, GPIO_INT_EDGE_TO_ACTIVE);
        gpio_pin_configure_dt(&button1_spec, GPIO_INPUT);
        gpio_pin_interrupt_configure_dt(&button1_spec, GPIO_INT_EDGE_TO_ACTIVE);
        gpio_init_callback(&button_cb, button_pressed_cb, BIT(button0_spec.pin) | BIT(button1_spec.pin));
        gpio_add_callback(button0_spec.port, &button_cb);
        gpio_add_callback(button1_spec.port, &button_cb);

        printk("Setting timer.\n");
        k_timer_init(&send_timer, send_timer_callback, NULL);

        while (1)
        {
                k_msleep(SLEEP_TIME_MS);
        }
        return 0;
}
```

## src/ccs811.c
```c
// src/ccs811.c

#include "ccs811.h"
#include <zephyr/device.h>
#include <zephyr/drivers/i2c.h>
#include <zephyr/kernel.h>
#include <zephyr/sys/printk.h>

// #define CCS811_STATUS_REGISTER 0x00
// #define CCS811_APP_START 0xF4
// #define CCS811_MEAS_MODE 0x01

// int ccs811_init(struct ccs811_data *data, const struct device *i2c_dev, uint8_t address)
// {
//     data->i2c_dev = i2c_dev;
//     data->address = address;

//     uint8_t status;

//     // Check sensor status
//     if (i2c_reg_read_byte(data->i2c_dev, data->address, CCS811_STATUS_REGISTER, &status) < 0)
//     {
//         printk("Failed to read status register\n");
//         return -EIO;
//     }
//     printk("Initial status: 0x%x\n", status);

//     // Ensure sensor is in boot mode
//     if ((status & 0x10) == 0)
//     {
//         printk("Sensor is not in boot mode\n");
//         return -EIO;
//     }

//     // Send application start command
//     uint8_t app_start_cmd = CCS811_APP_START;
//     if (i2c_write(data->i2c_dev, &app_start_cmd, 1, data->address) < 0)
//     {
//         printk("Failed to send application start command\n");
//         return -EIO;
//     }

//     k_sleep(K_MSEC(100));

//     // Check status after app start
//     if (i2c_reg_read_byte(data->i2c_dev, data->address, CCS811_STATUS_REGISTER, &status) < 0)
//     {
//         printk("Failed to read status after app start\n");
//         return -EIO;
//     }
//     printk("Status after app start: 0x%x\n", status);

//     if ((status & 0x80) == 0)
//     {
//         printk("Sensor failed to start application mode\n");
//         return -EIO;
//     }

//     // Set measurement mode
//     uint8_t meas_mode[] = {CCS811_MEAS_MODE, 0x10}; // Drive Mode 1 (constant power mode, measurement every second)
//     if (i2c_write(data->i2c_dev, meas_mode, sizeof(meas_mode), data->address) < 0)
//     {
//         printk("Failed to set measurement mode\n");
//         return -EIO;
//     }

//     return 0;
// }

// bool ccs811_data_ready(struct ccs811_data *data)
// {
//     uint8_t status;
//     if (i2c_reg_read_byte(data->i2c_dev, data->address, CCS811_STATUS_REGISTER, &status) < 0)
//     {
//         printk("Failed to read status for data ready check\n");
//         return false;
//     }
//     printk("Status for data ready check: 0x%x\n", status);

//     return (status & 0x08);
// }

// int ccs811_read(struct ccs811_data *data, uint16_t *eco2, uint16_t *tvoc)
// {
//     uint8_t buffer[5];
//     if (i2c_burst_read(data->i2c_dev, data->address, 0x02, buffer, 5) < 0)
//     {
//         printk("Failed to read sensor data\n");
//         return -EIO;
//     }

//     *eco2 = ((uint16_t)buffer[0] << 8) | buffer[1];
//     *tvoc = ((uint16_t)buffer[2] << 8) | buffer[3];

//     return 0;
// }

#define CCS811_STATUS_REGISTER 0x00
#define CCS811_APP_START 0xF4
#define CCS811_MEAS_MODE 0x01

int ccs811_init(struct ccs811_data *data, const struct device *i2c_dev, uint8_t address)
{
    data->i2c_dev = i2c_dev;
    data->address = address;

    uint8_t status;

    // Check sensor status
    if (i2c_reg_read_byte(data->i2c_dev, data->address, CCS811_STATUS_REGISTER, &status) < 0)
    {
        printk("Failed to read status register\n");
        return -EIO;
    }
    printk("Initial status: 0x%x\n", status);

    // Ensure sensor is in boot mode
    if ((status & 0x10) == 0)
    {
        printk("Sensor is not in boot mode\n");
        return -EIO;
    }

    // Send application start command
    uint8_t app_start_cmd = CCS811_APP_START;
    if (i2c_write(data->i2c_dev, &app_start_cmd, 1, data->address) < 0)
    {
        printk("Failed to send application start command\n");
        return -EIO;
    }

    k_sleep(K_MSEC(100));

    // Check status after app start
    if (i2c_reg_read_byte(data->i2c_dev, data->address, CCS811_STATUS_REGISTER, &status) < 0)
    {
        printk("Failed to read status after app start\n");
        return -EIO;
    }
    printk("Status after app start: 0x%x\n", status);

    if ((status & 0x80) == 0)
    {
        printk("Sensor failed to start application mode\n");
        return -EIO;
    }

    // Set measurement mode
    uint8_t meas_mode[] = {CCS811_MEAS_MODE, 0x10}; // Drive Mode 1 (constant power mode, measurement every second)
    if (i2c_write(data->i2c_dev, meas_mode, sizeof(meas_mode), data->address) < 0)
    {
        printk("Failed to set measurement mode\n");
        return -EIO;
    }

    return 0;
}

bool ccs811_data_ready(struct ccs811_data *data)
{
    uint8_t status;
    if (i2c_reg_read_byte(data->i2c_dev, data->address, CCS811_STATUS_REGISTER, &status) < 0)
    {
        printk("Failed to read status for data ready check\n");
        return false;
    }
    // printk("Status for data ready check: 0x%x\n", status);

    return (status & 0x08);
}

int ccs811_read(struct ccs811_data *data, uint16_t *eco2, uint16_t *tvoc)
{
    uint8_t buffer[5];
    if (i2c_burst_read(data->i2c_dev, data->address, 0x02, buffer, 5) < 0)
    {
        printk("Failed to read sensor data\n");
        return -EIO;
    }

    *eco2 = ((uint16_t)buffer[0] << 8) | buffer[1];
    *tvoc = ((uint16_t)buffer[2] << 8) | buffer[3];

    return 0;
}
```

## src/hal.c
```c
/*
 * Copyright (c) 2018, Sensirion AG
 * All rights reserved.
 *
 * Redistribution and use in source and binary forms, with or without
 * modification, are permitted provided that the following conditions are met:
 *
 * * Redistributions of source code must retain the above copyright notice, this
 *   list of conditions and the following disclaimer.
 *
 * * Redistributions in binary form must reproduce the above copyright notice,
 *   this list of conditions and the following disclaimer in the documentation
 *   and/or other materials provided with the distribution.
 *
 * * Neither the name of Sensirion AG nor the names of its
 *   contributors may be used to endorse or promote products derived from
 *   this software without specific prior written permission.
 *
 * THIS SOFTWARE IS PROVIDED BY THE COPYRIGHT HOLDERS AND CONTRIBUTORS "AS IS"
 * AND ANY EXPRESS OR IMPLIED WARRANTIES, INCLUDING, BUT NOT LIMITED TO, THE
 * IMPLIED WARRANTIES OF MERCHANTABILITY AND FITNESS FOR A PARTICULAR PURPOSE
 * ARE DISCLAIMED. IN NO EVENT SHALL THE COPYRIGHT HOLDER OR CONTRIBUTORS BE
 * LIABLE FOR ANY DIRECT, INDIRECT, INCIDENTAL, SPECIAL, EXEMPLARY, OR
 * CONSEQUENTIAL DAMAGES (INCLUDING, BUT NOT LIMITED TO, PROCUREMENT OF
 * SUBSTITUTE GOODS OR SERVICES; LOSS OF USE, DATA, OR PROFITS; OR BUSINESS
 * INTERRUPTION) HOWEVER CAUSED AND ON ANY THEORY OF LIABILITY, WHETHER IN
 * CONTRACT, STRICT LIABILITY, OR TORT (INCLUDING NEGLIGENCE OR OTHERWISE)
 * ARISING IN ANY WAY OUT OF THE USE OF THIS SOFTWARE, EVEN IF ADVISED OF THE
 * POSSIBILITY OF SUCH DAMAGE.
 */

#include <zephyr/device.h>
#include <zephyr/drivers/i2c.h>
#include <zephyr/kernel.h>

#include "sensirion_arch_config.h"
#include "sensirion_common.h"
// #include "sensirion_i2c.h"

/* I2C device. */
#define I2C_NODE DT_NODELABEL(i2c0)
static const struct device *i2c_dev = DEVICE_DT_GET(I2C_NODE);
/**
 * Select the current i2c bus by index.
 * All following i2c operations will be directed at that bus.
 *
 * @param bus_idx   Bus index to select
 * @returns         0 on success, an error code otherwise
 */
int16_t sensirion_i2c_select_bus(uint8_t bus_idx)
{
    char bus_name[6] = "I2C_0";

    if (bus_idx > 9)
    {
        /* Invalid bus index */
        return STATUS_FAIL;
    }

    bus_name[4] = bus_idx + '0';
    i2c_dev = device_get_binding(bus_name);
    if (i2c_dev == NULL)
    {
        /* No valid device found */
        return STATUS_FAIL;
    }

    return STATUS_OK;
}

/**
 * Initialize all hard- and software components that are needed for the I2C
 * communication.
 */
void sensirion_i2c_init(void)
{
    /* Device (specified by sps30_i2c_dev) is already initialized by the Zephyr
     * boot-up process. Nothing to be done here. */
}

/**
 * Release all resources initialized by sensirion_i2c_init().
 */
void sensirion_i2c_release(void)
{
    i2c_dev = NULL;
}

/**
 * Execute one read transaction on the I2C bus, reading a given number of bytes.
 * If the device does not acknowledge the read command, an error shall be
 * returned.
 *
 * @param address 7-bit I2C address to read from
 * @param data    pointer to the buffer where the data is to be stored
 * @param count   number of bytes to read from I2C and store in the buffer
 * @returns 0 on success, error code otherwise
 */
int8_t sensirion_i2c_read(uint8_t address, uint8_t *data, uint16_t count)
{
    return i2c_read(i2c_dev, data, count, address);
}

/**
 * Execute one write transaction on the I2C bus, sending a given number of
 * bytes. The bytes in the supplied buffer must be sent to the given address. If
 * the slave device does not acknowledge any of the bytes, an error shall be
 * returned.
 *
 * @param address 7-bit I2C address to write to
 * @param data    pointer to the buffer containing the data to write
 * @param count   number of bytes to read from the buffer and send over I2C
 * @returns 0 on success, error code otherwise
 */
int8_t sensirion_i2c_write(uint8_t address, const uint8_t *data,
                           uint16_t count)
{
    return i2c_write(i2c_dev, data, count, address);
}

/**
 * Sleep for a given number of microseconds. The function should delay the
 * execution for at least the given time, but may also sleep longer.
 *
 * Despite the unit, a <10 millisecond precision is sufficient.
 *
 * @param useconds the sleep time in microseconds
 */
void sensirion_sleep_usec(uint32_t useconds)
{
    int32_t remaining = useconds;
    while (remaining > 0)
    {
        remaining = k_usleep(remaining);
    }
}
```

## src/main.bak.c
```c
#include <stdio.h>
#include <zephyr/kernel.h>
#include <zephyr/device.h>
#include <zephyr/drivers/gpio.h>
#include <zephyr/net/openthread.h>
#include <zephyr/net/coap.h>
#include <openthread/thread.h>
#include <openthread/udp.h>
#include <openthread/coap.h>
#include <zephyr/drivers/sensor.h>
#include <zephyr/drivers/i2c.h>
#include <zephyr/sys/printk.h>
#include <zephyr/sys/util.h>
#include "../sensors/scd41/scd4x_i2c.h"
#include "../sensors/scd41/sensirion_common.h"
#include "../sensors/scd41/sensirion_i2c_hal.h"
#include "../sensors/ccs811/ccs811.h"
#include "../sensors/sps30/sps30.h"

#define SLEEP_TIME_MS 1000
#define DATA_SENDING_INTERVAL 60000
#define TEXTBUFFER_SIZE 30
#define BUTTON0_NODE DT_NODELABEL(button0)
#define BUTTON1_NODE DT_NODELABEL(button1)

static const struct gpio_dt_spec button0_spec = GPIO_DT_SPEC_GET(BUTTON0_NODE, gpios);
static const struct gpio_dt_spec button1_spec = GPIO_DT_SPEC_GET(BUTTON1_NODE, gpios);
static struct gpio_callback button_cb;

static struct k_timer send_timer;
static volatile bool function_running = false;
static char sensors_data[256];

int16_t get_serial(int16_t error, int16_t serial_0, int16_t serial_1, int16_t serial_2);
void read_scd41();
void read_ccs811(struct ccs811_data *ccs811);
void read_sps30();

static void coap_send_data_request(struct k_work *work);
static void coap_send_data_response_cb(void *p_context, otMessage *p_message, const otMessageInfo *p_message_info, otError result);

struct sensor_value temperature, humidity, co2, eco2, tvoc;
struct ccs811_data ccs811;
struct sps30_measurement m;
int16_t ret;

#define I2C_DEV DT_LABEL(DT_ALIAS(i2c0))
#define I2C_NODE DT_NODELABEL(i2c0)
#define I2C_DEV_LABEL DT_LABEL(DT_NODELABEL(i2c0))
#define CCS811_I2C_ADDRESS 0x5A

int16_t get_serial(int16_t error, int16_t serial_0, int16_t serial_1, int16_t serial_2)
{
        error = scd4x_get_serial_number(&serial_0, &serial_1, &serial_2);
        return error;
}

void read_scd41()
{
        int16_t error;
        bool data_ready_flag = false;
        error = scd4x_get_data_ready_flag(&data_ready_flag);
        if (error)
        {
                printf("Error executing scd4x_get_data_ready_flag(): %i\n", error);
                return;
        }
        if (!data_ready_flag)
        {
                return;
        }

        error = scd4x_read_measurement(&co2, &temperature, &humidity);
        if (error)
        {
                printf("Error executing scd4x_read_measurement(): %i\n", error);
                return;
        }
        else if (sensor_value_to_double(&co2) == 0)
        {
                printf("Invalid sample detected, skipping.\n");
        }
}

void read_ccs811(struct ccs811_data *ccs811)
{
        if (ccs811_data_ready(ccs811))
        {
                if (ccs811_read(ccs811, &eco2, &tvoc) == 0)
                {
                        printk("Data read from CCS811\n");
                }
                else
                {
                        printk("Failed to read CCS811 sensor data\n");
                }
        }
        else
        {
                printk("CCS811 data not ready\n");
        }
}

void read_sps30()
{
        sensirion_sleep_usec(SPS30_MEASUREMENT_DURATION_USEC);
        ret = sps30_read_measurement(&m);
        if (ret < 0)
        {
                printk("Error reading measurement\n");
        }
        else
        {
                printk("SPS30:\n"
                       "PM1.0: %0.2f ug/m3\n"
                       "PM2.5: %0.2f ug/m3\n"
                       "PM4.0: %0.2f ug/m3\n"
                       "PM10: %0.2f ug/m3\n"
                       "NC0.5: %0.2f #/cm3\n"
                       "NC1.0: %0.2f #/cm3\n"
                       "NC2.5: %0.2f #/cm3\n"
                       "NC4.0: %0.2f #/cm3\n"
                       "NC10: %0.2f #/cm3\n"
                       "Typical Particle Size: %0.2f um\n\n",
                       m.mc_1p0, m.mc_2p5, m.mc_4p0, m.mc_10p0, m.nc_0p5, m.nc_1p0,
                       m.nc_2p5, m.nc_4p0, m.nc_10p0, m.typical_particle_size);
        }
}

static void coap_send_data_request(struct k_work *work)
{
        // char sensors_data[160];
        otError error = OT_ERROR_NONE;
        otMessage *myMessage;
        otMessageInfo myMessageInfo;
        otInstance *myInstance = openthread_get_default_instance();
        const char *serverIpAddr = "fd00:0:fb01:1:c9bd:dc9d:23e:82c5";

        printk("Sending payload!\n");

        do
        {
                read_scd41();
                read_ccs811(&ccs811);
                read_sps30();

                myMessage = otCoapNewMessage(myInstance, NULL);
                if (myMessage == NULL)
                {
                        printk("Failed to allocate message for CoAP Request\n");
                        return;
                }
                otCoapMessageInit(myMessage, OT_COAP_TYPE_CONFIRMABLE, OT_COAP_CODE_PUT);
                error = otCoapMessageAppendUriPathOptions(myMessage, "storedata");
                if (error != OT_ERROR_NONE)
                {
                        break;
                }
                error = otCoapMessageAppendContentFormatOption(myMessage, OT_COAP_OPTION_CONTENT_FORMAT_JSON);
                if (error != OT_ERROR_NONE)
                {
                        break;
                }
                error = otCoapMessageSetPayloadMarker(myMessage);
                if (error != OT_ERROR_NONE)
                {
                        break;
                }
                // printk("%.2f", sensor_value_to_double(&tvoc));
                const double calculated_humidity = sensor_value_to_double(&humidity) / 1000.0;
                const double calculated_temperature = sensor_value_to_double(&temperature) / 1000.0;
                snprintf(sensors_data, sizeof(sensors_data),
                         "{\"CO\":%.2f,\"Hm\":%.2f,\"Tp\":%.2f,\"eCO\":%.2f,\"1p0\":%.2f,\"2p5\":%.2f,\"4p0\":%.2f,\"10p0\":%.2f,\"ps\":%.2f,\"tv\":%.2f}",
                         sensor_value_to_double(&co2),
                         calculated_humidity,
                         calculated_temperature,
                         sensor_value_to_double(&eco2),
                         m.mc_1p0,
                         m.mc_2p5, m.mc_4p0, m.mc_10p0, m.typical_particle_size, sensor_value_to_double(&tvoc));
                //  sensor_value_to_double(&tvoc),
                sensors_data[159] = '\0';

                error = otMessageAppend(myMessage, sensors_data, strlen(sensors_data));
                if (error != OT_ERROR_NONE)
                {
                        printk("Ops!");
                        break;
                }
                memset(sensors_data, 0, sizeof(sensors_data));
                memset(&myMessageInfo, 0, sizeof(myMessageInfo));
                myMessageInfo.mPeerPort = OT_DEFAULT_COAP_PORT;

                error = otIp6AddressFromString(serverIpAddr, &myMessageInfo.mPeerAddr);
                if (error != OT_ERROR_NONE)
                {
                        break;
                }

                error = otCoapSendRequest(myInstance, myMessage, &myMessageInfo, coap_send_data_response_cb, NULL);

        } while (false);
        if (error != OT_ERROR_NONE)
        {
                printk("Failed to send CoAP Request: %d\n", error);
                otMessageFree(myMessage);
        }
        else
        {
                printk("CoAP data send.\n");
        }
        // free(sensors_data);
}

K_WORK_DEFINE(sensor_work, coap_send_data_request);

static void coap_send_data_response_cb(void *p_context, otMessage *p_message, const otMessageInfo *p_message_info, otError result)
{
        if (result == OT_ERROR_NONE)
        {
                printk("Delivery confirmed.\n");
        }
        else
        {
                printk("Delivery not confirmed: %d\n", result);
        }
}

void coap_init()
{
        otInstance *p_instance = openthread_get_default_instance();
        otError error = otCoapStart(p_instance, OT_DEFAULT_COAP_PORT);
        if (error != OT_ERROR_NONE)
                printk("Failed to start Coap: %d\n", error);
        else
                printk("COAP init success!\n");
}

void button_pressed_cb(const struct device *dev, struct gpio_callback *cb, uint32_t pins)
{
        if (pins & BIT(button0_spec.pin))
        {
                function_running = true;
                printk("Start sending data....\n");
                k_timer_start(&send_timer, K_NO_WAIT, K_MSEC(DATA_SENDING_INTERVAL));
        }
        else if (pins & BIT(button1_spec.pin))
        {
                function_running = false;
                printk("Stop sending data....\n");
                k_timer_stop(&send_timer);
        }
}

void send_timer_callback(struct k_timer *timer_id)
{
        if (function_running)
        {
                printk("Submitting worker.\n");
                k_work_submit(&sensor_work);
        }
}

int main(void)
{
        printk("Initializing SCD41\n");
        int16_t error = 0;
        sensirion_i2c_hal_init();
        scd4x_wake_up();
        scd4x_stop_periodic_measurement();
        scd4x_reinit();

        uint16_t serial_0 = 0;
        uint16_t serial_1 = 0;
        uint16_t serial_2 = 0;

        error = get_serial(error, serial_0, serial_1, serial_2);
        if (error)
        {
                printk("Error executing scd4x_get_serial_number(): %i\n", error);
        }
        else
        {
                printk("serial: 0x%04x%04x%04x\n", serial_0, serial_1, serial_2);
        }

        error = scd4x_start_periodic_measurement();
        if (error)
        {
                printk("Error executing scd4x_start_periodic_measurement(): %i\n", error);
        }

        printk("Initializing CCS811\n");

        static const struct device *i2c_dev = DEVICE_DT_GET(I2C_NODE);

        sensirion_i2c_init();

        if (i2c_dev == NULL)
        {
                printk("Failed to get I2C device\n");
                return -1;
        }
        printk("I2C device found\n");

        if (ccs811_init(&ccs811, i2c_dev, CCS811_I2C_ADDRESS) != 0)
        {
                printk("Failed to initialize CCS811 sensor\n");
        }
        printk("CCS811 initialized\n");

        while (sps30_probe() != 0)
        {
                printk("SPS30 sensor probing failed\n");
                k_sleep(K_SECONDS(1));
        }
        printk("SPS sensor probing successful\n");

        ret = sps30_start_measurement();
        if (ret < 0)
                printk("Error starting measurement\n");

        printk("Initializing COAP\n");
        coap_init();

        gpio_pin_configure_dt(&button0_spec, GPIO_INPUT);
        gpio_pin_interrupt_configure_dt(&button0_spec, GPIO_INT_EDGE_TO_ACTIVE);
        gpio_pin_configure_dt(&button1_spec, GPIO_INPUT);
        gpio_pin_interrupt_configure_dt(&button1_spec, GPIO_INT_EDGE_TO_ACTIVE);
        gpio_init_callback(&button_cb, button_pressed_cb, BIT(button0_spec.pin) | BIT(button1_spec.pin));
        gpio_add_callback(button0_spec.port, &button_cb);
        gpio_add_callback(button1_spec.port, &button_cb);

        printk("Setting timer.\n");
        k_timer_init(&send_timer, send_timer_callback, NULL);

        while (1)
        {
                k_msleep(SLEEP_TIME_MS);
        }
        return 0;
}
```

## src/temp.c
```c
// Define a larger buffer size
#define SENSOR_DATA_BUFFER_SIZE 512

static void coap_send_data_request(struct k_work *work)
{
    char sensors_data[SENSOR_DATA_BUFFER_SIZE];
    otError error = OT_ERROR_NONE;
    otMessage *myMessage;
    otMessageInfo myMessageInfo;
    otInstance *myInstance = openthread_get_default_instance();
    const otMeshLocalPrefix *ml_prefix = otThreadGetMeshLocalPrefix(myInstance);
    uint8_t serverInterfaceID[8] = {0x00, 0x00, 0x00, 0x00, 0x00, 0x00, 0x00, 0x01};
    const char *serverIpAddr = "fd00:0:fb01:1:c9bd:dc9d:23e:82c5";
    const char *myTemperatureJson = "{\"temperature\": 23.32}";

    printk("Sending payload!\n");

    do
    {
        read_scd41();
        read_ccs811(ccs811);
        read_sps30();

        // Create the sensor data JSON string
        int ret = snprintf(sensors_data, sizeof(sensors_data),
                           "{\"CO2\": %.2f, \"Humidity\": %.2f, \"Temperature\": %.2f, \"eCO2\": %.2f, \"TVOC\": %.2f, "
                           "\"PM1.0\": %.2f, \"PM2.5\": %.2f, \"PM4.0\": %.2f, \"PM10\": %.2f}",
                           sensor_value_to_double(&co2),
                           sensor_value_to_double(&humidity) / 1000.0,
                           sensor_value_to_double(&temperature) / 1000.0,
                           sensor_value_to_double(&eco2),
                           sensor_value_to_double(&tvoc),
                           m.mc_1p0, m.mc_2p5, m.mc_4p0, m.mc_10p0);

        if (ret < 0 || ret >= sizeof(sensors_data))
        {
            printk("Error creating sensor data string, snprintf returned %d\n", ret);
            break;
        }

        myMessage = otCoapNewMessage(myInstance, NULL);
        if (myMessage == NULL)
        {
            printk("Failed to allocate message for CoAP Request\n");
            return;
        }
        otCoapMessageInit(myMessage, OT_COAP_TYPE_CONFIRMABLE, OT_COAP_CODE_PUT);
        error = otCoapMessageAppendUriPathOptions(myMessage, "storedata");
        if (error != OT_ERROR_NONE)
        {
            break;
        }
        error = otCoapMessageAppendContentFormatOption(myMessage,
                                                       OT_COAP_OPTION_CONTENT_FORMAT_JSON);
        if (error != OT_ERROR_NONE)
        {
            break;
        }
        error = otCoapMessageSetPayloadMarker(myMessage);
        if (error != OT_ERROR_NONE)
        {
            break;
        }

        printk("%s\n", sensors_data);

        error = otMessageAppend(myMessage, sensors_data,
                                strlen(sensors_data));
        if (error != OT_ERROR_NONE)
        {
            break;
        }
        memset(&myMessageInfo, 0, sizeof(myMessageInfo));
        memset(sensors_data, 0, sizeof(sensors_data));
        myMessageInfo.mPeerPort = OT_DEFAULT_COAP_PORT;

        error = otIp6AddressFromString(serverIpAddr, &myMessageInfo.mPeerAddr);
        if (error != OT_ERROR_NONE)
        {
            break;
        }

        error = otCoapSendRequest(myInstance, myMessage, &myMessageInfo,
                                  coap_send_data_response_cb, NULL);

    } while (false);
    if (error != OT_ERROR_NONE)
    {
        printk("Failed to send CoAP Request: %d\n", error);
        otMessageFree(myMessage);
    }
    else
    {
        printk("CoAP data sent.\n");
    }
}
```
